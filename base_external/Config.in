## base_external/Config.in
```kconfig
source "$BR2_EXTERNAL_project_base_PATH/package/wwwroot/Config.in"
source "$BR2_EXTERNAL_project_base_PATH/package/bbe_sensors/Config.in"
```

## base_external/configs/aesd_beaglebone_defconfig
```kconfig
BR2_arm=y
BR2_cortex_a8=y
BR2_ARM_FPU_VFPV3=y
BR2_PACKAGE_HOST_LINUX_HEADERS_CUSTOM_6_1=y
BR2_DL_DIR="$(HOME)/.dl"
BR2_CCACHE=y
BR2_CCACHE_DIR="$(HOME)/ccache/beaglenas"
BR2_TARGET_GENERIC_HOSTNAME="beaglenas"
BR2_TARGET_GENERIC_ISSUE="Welcome to BeagleNAS"
BR2_ROOTFS_DEVICE_CREATION_DYNAMIC_MDEV=y
BR2_TARGET_GENERIC_ROOT_PASSWD="beaglepass"
BR2_TARGET_TZ_INFO=y
BR2_ROOTFS_OVERLAY="../base_external/rootfs_overlay_beaglebone"
BR2_ROOTFS_POST_BUILD_SCRIPT="../base_external/sancloud/post-build.sh"
BR2_ROOTFS_POST_IMAGE_SCRIPT="support/scripts/genimage.sh"
BR2_ROOTFS_POST_SCRIPT_ARGS="-c ../base_external/sancloud/genimage.cfg"
BR2_LINUX_KERNEL=y
BR2_LINUX_KERNEL_CUSTOM_TARBALL=y
BR2_LINUX_KERNEL_CUSTOM_TARBALL_LOCATION="$(call github,beagleboard,linux,6.1.46-ti-r13)/linux-6.1.46-ti-r13.tar.gz"
BR2_LINUX_KERNEL_DEFCONFIG="bb.org"
BR2_LINUX_KERNEL_DTS_SUPPORT=y
BR2_LINUX_KERNEL_INTREE_DTS_NAME="am335x-sancloud-bbe am335x-sancloud-bbe-extended-wifi am335x-sancloud-bbe-lite"
BR2_LINUX_KERNEL_DTB_KEEP_DIRNAME=y
BR2_LINUX_KERNEL_INSTALL_TARGET=y
BR2_LINUX_KERNEL_NEEDS_HOST_OPENSSL=y
BR2_PACKAGE_BUSYBOX_SHOW_OTHERS=y
BR2_PACKAGE_XZ=y
BR2_PACKAGE_KMOD=y
BR2_PACKAGE_KMOD_TOOLS=y
BR2_TARGET_ROOTFS_EXT2=y
BR2_TARGET_ROOTFS_EXT2_4=y
BR2_TARGET_ROOTFS_EXT2_SIZE="800M"
BR2_TARGET_UBOOT=y
BR2_TARGET_UBOOT_BUILD_SYSTEM_KCONFIG=y
BR2_TARGET_UBOOT_CUSTOM_VERSION=y
BR2_TARGET_UBOOT_CUSTOM_VERSION_VALUE="2023.10"
BR2_TARGET_UBOOT_BOARD_DEFCONFIG="am335x_evm"
BR2_TARGET_UBOOT_NEEDS_DTC=y
BR2_TARGET_UBOOT_NEEDS_OPENSSL=y
# BR2_TARGET_UBOOT_FORMAT_BIN is not set
BR2_TARGET_UBOOT_FORMAT_IMG=y
BR2_TARGET_UBOOT_SPL=y
BR2_TARGET_UBOOT_SPL_NAME="MLO"
BR2_PACKAGE_HOST_DOSFSTOOLS=y
BR2_PACKAGE_HOST_GENIMAGE=y
BR2_PACKAGE_HOST_KMOD_XZ=y
BR2_PACKAGE_HOST_MTOOLS=y
```

## base_external/configs/sancloud_defconfig
```kconfig
BR2_arm=y
BR2_cortex_a8=y
BR2_ARM_FPU_VFPV3=y
BR2_PACKAGE_HOST_LINUX_HEADERS_CUSTOM_6_1=y
BR2_DL_DIR="$(HOME)/.dl"
BR2_CCACHE=y
BR2_CCACHE_DIR="$(HOME)/ccache/beaglenas"
BR2_FORCE_HOST_BUILD=y
BR2_TARGET_GENERIC_HOSTNAME="beaglenas"
BR2_TARGET_GENERIC_ISSUE="Welcome to BeagleNAS"
BR2_ROOTFS_DEVICE_CREATION_DYNAMIC_EUDEV=y
BR2_TARGET_GENERIC_ROOT_PASSWD="beaglepass"
BR2_TARGET_TZ_INFO=y
BR2_ROOTFS_OVERLAY="../base_external/rootfs_overlay"
BR2_ROOTFS_POST_BUILD_SCRIPT="../base_external/board/sancloud-bbe/post-build.sh"
BR2_ROOTFS_POST_IMAGE_SCRIPT="support/scripts/genimage.sh"
BR2_ROOTFS_POST_SCRIPT_ARGS="-c ../base_external/board/sancloud-bbe/genimage.cfg"
BR2_LINUX_KERNEL=y
BR2_LINUX_KERNEL_CUSTOM_TARBALL=y
BR2_LINUX_KERNEL_CUSTOM_TARBALL_LOCATION="$(call github,beagleboard,linux,6.1.46-ti-r13)/linux-6.1.46-ti-r13.tar.gz"
BR2_LINUX_KERNEL_DEFCONFIG="bb.org"
BR2_LINUX_KERNEL_DTS_SUPPORT=y
BR2_LINUX_KERNEL_INTREE_DTS_NAME="am335x-sancloud-bbe am335x-sancloud-bbe-extended-wifi am335x-sancloud-bbe-lite"
BR2_LINUX_KERNEL_DTB_KEEP_DIRNAME=y
BR2_LINUX_KERNEL_INSTALL_TARGET=y
BR2_LINUX_KERNEL_NEEDS_HOST_OPENSSL=y
BR2_PACKAGE_BUSYBOX_SHOW_OTHERS=y
BR2_PACKAGE_XZ=y
BR2_PACKAGE_E2FSPROGS_FUSE2FS=y
BR2_PACKAGE_E2FSPROGS_RESIZE2FS=y
BR2_PACKAGE_MTOOLS=y
BR2_PACKAGE_NFS_UTILS=y
BR2_PACKAGE_NFS_UTILS_NFSV4=y
BR2_PACKAGE_NTFS_3G=y
BR2_PACKAGE_NTFS_3G_NTFSPROGS=y
BR2_PACKAGE_DBUS_GLIB=y
BR2_PACKAGE_SG3_UTILS=y
BR2_PACKAGE_USBMOUNT=y
BR2_PACKAGE_LIBATASMART=y
BR2_PACKAGE_LIBBLOCKDEV=y
BR2_PACKAGE_LIBBLOCKDEV_CRYPTO=y
BR2_PACKAGE_LIBBLOCKDEV_FS=y
BR2_PACKAGE_LIBBLOCKDEV_LOOP=y
BR2_PACKAGE_LIBBLOCKDEV_MDRAID=y
BR2_PACKAGE_LIBBLOCKDEV_NVME=y
BR2_PACKAGE_LIBBLOCKDEV_PART=y
BR2_PACKAGE_LIBBLOCKDEV_SWAP=y
BR2_PACKAGE_LIBGUDEV=y
BR2_PACKAGE_LIBKRB5=y
BR2_PACKAGE_LIBNFNETLINK=y
BR2_PACKAGE_LIBPCAP=y
BR2_PACKAGE_MDNSD=y
BR2_PACKAGE_MDNSD_MQUERY=y
BR2_PACKAGE_MDNSD_HTTP_SERVICE=y
BR2_PACKAGE_DROPBEAR=y
BR2_PACKAGE_DROPBEAR_DISABLE_REVERSEDNS=y
BR2_PACKAGE_MINIDLNA=y
BR2_PACKAGE_NGINX=y
BR2_PACKAGE_NGINX_HTTP_SSL_MODULE=y
# BR2_PACKAGE_NGINX_HTTP_SSI_MODULE is not set
# BR2_PACKAGE_NGINX_HTTP_GEO_MODULE is not set
# BR2_PACKAGE_NGINX_HTTP_MAP_MODULE is not set
# BR2_PACKAGE_NGINX_HTTP_SPLIT_CLIENTS_MODULE is not set
# BR2_PACKAGE_NGINX_HTTP_PROXY_MODULE is not set
BR2_PACKAGE_NTP=y
BR2_PACKAGE_NTP_NTPDATE=y
BR2_PACKAGE_NTP_NTPQ=y
BR2_PACKAGE_NTP_NTPTIME=y
BR2_PACKAGE_SAMBA4=y
BR2_PACKAGE_SAMBA4_ADS=y
BR2_PACKAGE_ACL=y
BR2_PACKAGE_KMOD_TOOLS=y
BR2_PACKAGE_POLKIT=y
BR2_TARGET_ROOTFS_EXT2=y
BR2_TARGET_ROOTFS_EXT2_4=y
BR2_TARGET_ROOTFS_EXT2_SIZE="800M"
BR2_TARGET_UBOOT=y
BR2_TARGET_UBOOT_BUILD_SYSTEM_KCONFIG=y
BR2_TARGET_UBOOT_CUSTOM_VERSION=y
BR2_TARGET_UBOOT_CUSTOM_VERSION_VALUE="2023.10"
BR2_TARGET_UBOOT_BOARD_DEFCONFIG="am335x_evm"
BR2_TARGET_UBOOT_NEEDS_DTC=y
BR2_TARGET_UBOOT_NEEDS_OPENSSL=y
# BR2_TARGET_UBOOT_FORMAT_BIN is not set
BR2_TARGET_UBOOT_FORMAT_IMG=y
BR2_TARGET_UBOOT_SPL=y
BR2_TARGET_UBOOT_SPL_NAME="MLO"
BR2_PACKAGE_HOST_DOSFSTOOLS=y
BR2_PACKAGE_HOST_GENIMAGE=y
BR2_PACKAGE_HOST_KMOD_XZ=y
BR2_PACKAGE_HOST_MTOOLS=y
BR2_PACKAGE_NGINX_WEBROOT=y
```

## base_external/package/bbe_sensors/Config.in
```kconfig
config BR2_PACKAGE_BBE_SENSORS
	bool "bbe_sensors"
	help
		Simple test apps for the BBE sensors

		To build either use cross compliation toolchain and rootfs 
		reference for linking or copy folders to target and build
		with make.

		https://github.com/santanamobile/BBE_Sensors
```

## base_external/package/flask-webserver/Config.in
```kconfig
config BR2_PACKAGE_FLASK_WEBSERVER
	bool "flask-webserver"
	help
	  Flask webserver.
```

## base_external/package/nginx-webroot/Config.in
```kconfig
config BR2_PACKAGE_NGINX_WEBROOT
	bool "nginx-webroot"
	help
	  Files of the web interface.
```

## base_external/package/webroot/Config.in
```kconfig
config BR2_PACKAGE_WEBROOT
	bool "webroot"
	depends on BR2_PACKAGE_WEBSERVER
	help
		Static and dynamic files of the web interface.

		This interface based on AdminLTE
```

## base_external/package/webserver/Config.in
```kconfig
config BR2_PACKAGE_WEBSERVER
	bool "webserver"
	help
		Flask webserver.

		Python backend for system functions.
```

## base_external/package/wwwroot/Config.in
```kconfig
config BR2_PACKAGE_WWWROOT
	bool "wwwroot"
	help
		wwwroot

		Python-Flask backend for system functions.
		Static and dynamic files of the web interface based on AdminLTE
```
